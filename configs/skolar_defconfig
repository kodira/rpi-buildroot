## configs/skolar_defconfig
```kconfig
BR2_arm=y
BR2_arm1176jzf_s=y
BR2_HOST_DIR="/opt/raspi-sdk"
BR2_KERNEL_HEADERS_VERSION=y
BR2_DEFAULT_KERNEL_VERSION="3.11.10"
BR2_TOOLCHAIN_BUILDROOT_GLIBC=y
BR2_BINUTILS_VERSION_2_24=y
BR2_GCC_VERSION_4_8_X=y
BR2_EXTRA_GCC_CONFIG_OPTIONS="--with-float=hard"
BR2_TOOLCHAIN_BUILDROOT_CXX=y
BR2_PACKAGE_HOST_GDB=y
BR2_ENABLE_LOCALE_PURGE=y
BR2_ENABLE_LOCALE_WHITELIST="C en_US"
BR2_TARGET_OPTIMIZATION="-pipe -mhard-float"
BR2_TARGET_GENERIC_HOSTNAME="rpi"
BR2_TARGET_GENERIC_ISSUE="Skolar Display"
BR2_ROOTFS_DEVICE_CREATION_DYNAMIC_UDEV=y
BR2_ROOTFS_SKELETON_CUSTOM=y
BR2_ROOTFS_SKELETON_CUSTOM_PATH="board/raspberrypi/skeleton"
BR2_ROOTFS_POST_BUILD_SCRIPT="board/raspberrypi/postscript.sh"
BR2_LINUX_KERNEL=y
BR2_LINUX_KERNEL_CUSTOM_VERSION=y
BR2_LINUX_KERNEL_CUSTOM_VERSION_VALUE="3.11.10"
BR2_LINUX_KERNEL_PATCH="http://dl.guillermoamaral.com/rpi/kernel-3.11.10.patch"
BR2_LINUX_KERNEL_USE_CUSTOM_CONFIG=y
BR2_LINUX_KERNEL_CUSTOM_CONFIG_FILE="board/raspberrypi/linux-3.11.10/config"
BR2_LINUX_KERNEL_ZIMAGE=y
BR2_PACKAGE_SKOLAR_DISPLAY=y
BR2_PACKAGE_GDB=y
BR2_PACKAGE_QT5=y
BR2_PACKAGE_QT5BASE_LICENSE_APPROVED=y
BR2_PACKAGE_QT5BASE_FONTCONFIG=y
BR2_PACKAGE_QT5BASE_JPEG=y
BR2_PACKAGE_QT5BASE_PNG=y
BR2_PACKAGE_QT5BASE_DBUS=y
BR2_PACKAGE_QT5GRAPHICALEFFECTS=y
BR2_PACKAGE_QT5IMAGEFORMATS=y
BR2_PACKAGE_QT5MULTIMEDIA=y
BR2_PACKAGE_QT5QUICKCONTROLS=y
BR2_PACKAGE_LIBERATION=y
BR2_PACKAGE_KBD=y
BR2_PACKAGE_LIBCAP=y
BR2_PACKAGE_TZDATA=y
BR2_PACKAGE_PCRE_32=y
BR2_PACKAGE_GOOGLEFONTDIRECTORY=y
BR2_PACKAGE_GOOGLEFONTDIRECTORY_FONTS="roboto"
BR2_PACKAGE_DHCPCD=y
BR2_PACKAGE_NETWORK_MANAGER=y
BR2_PACKAGE_OPENSSH=y
BR2_PACKAGE_NANO=y
BR2_PACKAGE_RPI_USERLAND=y
BR2_TARGET_RPI_FIRMWARE=y
```
